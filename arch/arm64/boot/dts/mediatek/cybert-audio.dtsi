/* Copyright (c) 2024, Motorola Mobility Inc. All rights reserved.
 *
 * This program is free software; you can redistribute it and/or modify
 * it under the terms of the GNU General Public License version 2 and
 * only version 2 as published by the Free Software Foundation.
 *
 * This program is distributed in the hope that it will be useful,
 * but WITHOUT ANY WARRANTY; without even the implied warranty of
 * MERCHANTABILITY or FITNESS FOR A PARTICULAR PURPOSE.  See the
 * GNU General Public License for more details.
 */

/*&spk {
	status = "disable";
};

&i2c7 {
        status = "okay";
        clock-frequency = <400000>;

        tfa9864_spk: tfa98xx@35 {
                compatible = "tfa,tfa98xx";
                #address-cells = <1>;
                #size-cells = <0>;
                #sound-dai-cells = <0>;
                reg = <0x35>;
                reset-gpio= <&pio 21 0>;
                reset-polarity=<0>;
                status = "okay";
        };

        tfa9864_rcv: tfa98xx@34 {
                compatible = "tfa,tfa98xx";
                #address-cells = <1>;
                #size-cells = <0>;
                #sound-dai-cells = <0>;
                reg = <0x34>;
                reset-gpio= <&pio 22 0>;
                reset-polarity=<0>;
                status = "okay";
        };
};

&sound {
        mediatek,spk-i2s = <21 20>;
        mediatek,speaker-codec {
                sound-dai = <&tfa9864_spk &tfa9864_rcv>;
        };
};*/

&afe {
        mediatek,ap-dmic = <0>;
};

&i2c13 {
        status = "okay";
        clock-frequency = <400000>;

        fsa4480: fsa4480@42 {
                compatible = "fsa,fsa4480-i2c";
                reg = <0x42>;
                status = "okay";
        };
};
