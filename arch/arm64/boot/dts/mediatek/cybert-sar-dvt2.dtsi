/*
 * Copyright (c) 2021 MediaTek Inc.
 *
 * This program is free software; you can redistribute it and/or modify
 * it under the terms of the GNU General Public License version 2 as
 * published by the Free Software Foundation.
 *
 * This program is distributed in the hope that it will be useful,
 * but WITHOUT ANY WARRANTY; without even the implied warranty of
 * MERCHANTABILITY or FITNESS FOR A PARTICULAR PURPOSE.  See the
 * GNU General Public License for more details.
 */

&i2c0 {
	sx937x@2c { /* SAR sensor */
		Semtech,reg-num = <67>;
		Semtech,reg-init = <
			0x8024 0x7F00
			0x4004 0x70
			0x4280 0x0
			0x8020 0x32
			0x8028 0x456
			0x8034 0x456
			0x8040 0x44E
			0x804C 0x456
			0x8058 0x456
			0x8064 0x44E
			0x8070 0x456
			0x807C 0x0
			0x8030 0xFFF9FD
			0x803C 0xF7F9FF
			0x8048 0xFEF9FF
			0x8054 0xBFF9FF
			0x8060 0xFFF9EF
			0x806C 0xFFD9FF
			0x8078 0xFFF97F
			0x8084 0x0
			0x8098 0x884E
			0x80B8 0x4538
			0x80D8 0x884E
			0x80F8 0x3131
			0x8118 0x0
			0x8138 0x0
			0x8158 0x0
			0x8178 0x0
			0x80A0 0x12120001
			0x80C0 0x43430003
			0x80E0 0x28280002
			0x8100 0x23230001
			0x8120 0x0
			0x8140 0x0
			0x8160 0x0
			0x8180 0x0
			0x8188 0x8000014
			0x818C 0x8000015
			0x8190 0x8000016
			0x8194 0x0
			0x8090 0x64B07005
			0x80B0 0x64B07005
			0x80D0 0x64B07005
			0x80F0 0x64B07005
			0x8110 0x2AD66000
			0x8130 0x2AD66000
			0x8150 0x2AD66000
			0x8170 0x0
			0x8088 0x300000
			0x80A8 0x300000
			0x80C8 0x300000
			0x80E8 0x300000
			0x8108 0x300000
			0x8128 0x300000
			0x8148 0x300000
			0x8168 0x0
			0x808C 0xA0200031
			0x80AC 0xA0200031
			0x80CC 0xA0200031
			0x80EC 0xA0200031
			0x810C 0xA0200031
			0x812C 0xA0200031
			0x814C 0xA0200031
			0x816C 0x0
			0x4280 0xF
			0x8024 0x7F7F
			0x4280 0xE
		>;
	};
};

