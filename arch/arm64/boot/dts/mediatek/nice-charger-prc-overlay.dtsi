/*
 * Copyright (c) 2021 MediaTek Inc.
 *
 * This program is free software; you can redistribute it and/or modify
 * it under the terms of the GNU General Public License version 2 as
 * published by the Free Software Foundation.
 *
 * This program is distributed in the hope that it will be useful,
 * but WITHOUT ANY WARRANTY; without even the implied warranty of
 * MERCHANTABILITY or FITNESS FOR A PARTICULAR PURPOSE.  See the
 * GNU General Public License for more details.
 */
#include <dt-bindings/iio/adc/mediatek,mt6375_auxadc.h>
#include <dt-bindings/iio/adc/mediatek,mt6375_adc.h>
#include <dt-bindings/iio/mt635x-auxadc.h>

&charger {
	mmi,mmi-temp-zones = <0 4200 1168 0>,
				<10 4250 2920 1752>,
				<15 4500 2920 2920>,
				<45 4320 6000 5200>,
				<45 4450 5200 4000>,
				<45 4500 4000 4000>,
				<60 4200 2920 0>;
	mmi,mmi-ffc-zones = <0 4200 292>,
				<10 4500 292>,
				<15 4500 292>,
				<25 4530 757>,
				<35 4530 927>,
				<45 4530 1304>,
				<60 4200 292>;
	mmi,mmi-normal-zones = <0 4200 292>,
				<10 4500 292>,
				<15 4500 292>,
				<25 4500 292>,
				<35 4500 292>,
				<45 4500 584>,
				<60 4200 292>;
};

&moto_chg_tcmd {
	mmi,batt-ids-map = "1", "ATLRN60NVT", "2", "LWNRN60SWD";
};

&mtk_gauge {

	df-serialnum = "ATLRN60NVT";
	#include "bat_setting/mt6878_battery_table_nice_nvt_6000mah.dtsi"
	#include "bat_setting/mt6878_battery_table_nice_xwd_6000mah.dtsi"
};

