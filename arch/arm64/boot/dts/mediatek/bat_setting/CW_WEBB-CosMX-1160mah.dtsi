/*
 * Copyright (C) 2025 Motorola Inc.
 *
 * This program is free software; you can redistribute it and/or modify
 * it under the terms of the GNU General Public License version 2 as
 * published by the Free Software Foundation.
 *
 * This program is distributed in the hope that it will be useful,
 * but WITHOUT ANY WARRANTY; without even the implied warranty of
 * MERCHANTABILITY or FITNESS FOR A PARTICULAR PURPOSE.
 * See http://www.gnu.org/licenses/gpl-2.0.html for more details.
 */
webb-cosmx-1160mah {
	serialnum = "SB18E64743";
	fcc_design = <1160>;
	config_profile_info = [ 46 00 00 00 00 00 00 00
				B2 C0 C0 C5 B2 A9 CE B1
				9F DF C6 9A 8A 6D 5D 50
				47 43 3A 7C 59 E3 A2 FF
				E7 D9 D6 D4 D8 D8 DE DB
				CD CF CC C1 C3 C1 BB A9
				CE CE D6 CB EA FF FF FF
				20 00 AB 10 00 80 DA 00
				00 00 64 2F 90 12 00 00
				00 00 00 00 00 00 00 C7];
};
