/*
 * Copyright (C) 2024 Motorola Inc.
 *
 * This program is free software; you can redistribute it and/or modify
 * it under the terms of the GNU General Public License version 2 as
 * published by the Free Software Foundation.
 *
 * This program is distributed in the hope that it will be useful,
 * but WITHOUT ANY WARRANTY; without even the implied warranty of
 * MERCHANTABILITY or FITNESS FOR A PARTICULAR PURPOSE.
 * See http://www.gnu.org/licenses/gpl-2.0.html for more details.
 */
webb-atl-3340mah {
	serialnum = "SB18E56671";
	fcc_design = <3340>;
	config_profile_info = [ 46 00 00 00 00 00 00 00
				AE C1 AF C7 B4 AB C9 AA
				98 FF F6 C8 92 7A 61 51
				48 46 44 8D 68 E3 54 FF
				BE B7 C8 CF D8 E1 E6 DA
				DC D7 D0 D0 CD C8 BF D3
				D1 D9 CE E0 F7 FF FF FF
				20 00 AB 10 00 A2 93 00
				00 00 64 28 B1 84 00 00
				00 00 00 00 00 00 00 74];
};
