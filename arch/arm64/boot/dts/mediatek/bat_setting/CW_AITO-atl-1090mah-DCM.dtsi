/*
 * Copyright (C) 2023 Motorola Inc.
 *
 * This program is free software; you can redistribute it and/or modify
 * it under the terms of the GNU General Public License version 2 as
 * published by the Free Software Foundation.
 *
 * This program is distributed in the hope that it will be useful,
 * but WITHOUT ANY WARRANTY; without even the implied warranty of
 * MERCHANTABILITY or FITNESS FOR A PARTICULAR PURPOSE.
 * See http://www.gnu.org/licenses/gpl-2.0.html for more details.
 */
aito-atl-1090mah {
	serialnum = "SB18E39389";
	fcc_design = <1090>;
	config_profile_info = [ 46 00 00 00 00 00 00 00
				B7 AE C1 CA B6 AF C2 A0
				8C FF F7 A6 87 6F 5C 4D
				42 38 2B 86 58 E3 07 F2
				E6 C4 CC D3 DA DB D8 D4
				CF CC CD D6 B2 9D 92 89
				81 7B 87 91 A8 A0 5A F4
				20 00 AB 10 00 80 F7 00
				00 00 64 0E 90 2A 00 00
				00 00 00 00 00 00 00 A7];
};
