/*
 * Copyright (C) 2023 Motorola Inc.
 *
 * This program is free software; you can redistribute it and/or modify
 * it under the terms of the GNU General Public License version 2 as
 * published by the Free Software Foundation.
 *
 * This program is distributed in the hope that it will be useful,
 * but WITHOUT ANY WARRANTY; without even the implied warranty of
 * MERCHANTABILITY or FITNESS FOR A PARTICULAR PURPOSE.
 * See http://www.gnu.org/licenses/gpl-2.0.html for more details.
 */
aito-atl-1140mah {
	serialnum = "SB18E12803";
	fcc_design = <1140>;
	//ui_full = <98>;
	config_profile_info = [ 32 00 00 00 00 00 00 00
				A9 B8 B6 CC B6 B1 BD 99
				86 FF F9 C2 99 83 6C 5A
				4C 45 39 8E 5D E4 11 F5
				EB C0 CB D1 D9 DB DB DA
				DF D3 D4 C4 B2 AB AE AD
				BB AC C1 D0 D3 FD FF 62
				20 00 AB 10 00 80 95 00
				00 00 64 07 A3 B0 00 00
				00 00 00 00 00 00 00 71];
};
