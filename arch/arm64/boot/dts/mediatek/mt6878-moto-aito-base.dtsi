/* Copyright (c) 2024, Motorola Mobility Inc. All rights reserved.
 *
 * This program is free software; you can redistribute it and/or modify
 * it under the terms of the GNU General Public License version 2 and
 * only version 2 as published by the Free Software Foundation.
 *
 * This program is distributed in the hope that it will be useful,
 * but WITHOUT ANY WARRANTY; without even the implied warranty of
 * MERCHANTABILITY or FITNESS FOR A PARTICULAR PURPOSE.  See the
 * GNU General Public License for more details.
 */

&afe {
	/delete-property/ pinctrl-names;
	/delete-property/ pinctrl-0;
	/delete-property/ pinctrl-1;
	/delete-property/ pinctrl-2;
	/delete-property/ pinctrl-3;
	/delete-property/ pinctrl-4;
	/delete-property/ pinctrl-5;
	/delete-property/ pinctrl-6;
	/delete-property/ pinctrl-7;
	/delete-property/ pinctrl-8;
	/delete-property/ pinctrl-9;
	/delete-property/ pinctrl-10;
	/delete-property/ pinctrl-11;
	/delete-property/ pinctrl-12;
	/delete-property/ pinctrl-13;
	/delete-property/ pinctrl-14;
	/delete-property/ pinctrl-15;
	/delete-property/ pinctrl-16;
	/delete-property/ pinctrl-17;
	/delete-property/ pinctrl-18;
	/delete-property/ pinctrl-19;
	/delete-property/ pinctrl-20;
	/delete-property/ pinctrl-21;
	/delete-property/ pinctrl-22;
	/delete-property/ pinctrl-23;
	/delete-property/ aud-dat-miso0-off;
	/delete-property/ aud-dat-miso0-on;
	/delete-property/ vow-dat-miso-off;
	/delete-property/ vow-dat-miso-on;
	pinctrl-names = "aud-clk-mosi-off",
		"aud-clk-mosi-on",
		"aud-dat-mosi-off",
		"aud-dat-mosi-on",
		"aud-dat-miso1-off",
		"aud-dat-miso1-on",
		"aud-gpio-i2sin4-off",
		"aud-gpio-i2sin4-on",
		"aud-gpio-i2sout4-off",
		"aud-gpio-i2sout4-on",
		"aud-gpio-ap-dmic-off",
		"aud-gpio-ap-dmic-on",
		"aud-gpio-ap-dmic1-off",
		"aud-gpio-ap-dmic1-on",
		"vow-clk-miso-off",
		"vow-clk-miso-on",
		"vow-scp-dmic-dat-off",
		"vow-scp-dmic-dat-on",
		"vow-scp-dmic-clk-off",
		"vow-scp-dmic-clk-on";
	pinctrl-0 = <&aud_clk_mosi_off>;
	pinctrl-1 = <&aud_clk_mosi_on>;
	pinctrl-2 = <&aud_dat_mosi_off>;
	pinctrl-3 = <&aud_dat_mosi_on>;
	pinctrl-4 = <&aud_dat_miso1_off>;
	pinctrl-5 = <&aud_dat_miso1_on>;
	pinctrl-6 = <&aud_gpio_i2sin4_off>;
	pinctrl-7 = <&aud_gpio_i2sin4_on>;
	pinctrl-8 = <&aud_gpio_i2sout4_off>;
	pinctrl-9 = <&aud_gpio_i2sout4_on>;
	pinctrl-10 = <&aud_gpio_ap_dmic_off>;
	pinctrl-11 = <&aud_gpio_ap_dmic_on>;
	pinctrl-12 = <&aud_gpio_ap_dmic1_off>;
	pinctrl-13 = <&aud_gpio_ap_dmic1_on>;
	pinctrl-14 = <&vow_clk_miso_off>;
	pinctrl-15 = <&vow_clk_miso_on>;
	pinctrl-16 = <&vow_scp_dmic_dat_off>;
	pinctrl-17 = <&vow_scp_dmic_dat_on>;
	pinctrl-18 = <&vow_scp_dmic_clk_off>;
	pinctrl-19 = <&vow_scp_dmic_clk_on>;
	/* Only for ETDM in/out 4 */
	etdm-out-ch = <2>;
	etdm-in-ch = <2>;
	etdm-out-sync = <0>; /* 0: disable; 1: enable */
	etdm-in-sync = <1>; /* 0: disable; 1: enable */
	etdm-ip-mode = <0>; /* 0: One IP multi-channel 1: Multi-IP 2-channel */
};
